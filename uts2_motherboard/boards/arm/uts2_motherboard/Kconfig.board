## uts2_motherboard/boards/arm/uts2_motherboard/Kconfig.board
```kconfig
kconfig

config BOARD_UTS2_MOTHERBOARD
   bool "UTS2 Motherboard (STM32H723VG)"
   depends on SOC_STM32H723VG
```

## uts2_motherboard/boards/arm/uts2_motherboard/Kconfig.defconfig
```kconfig
kconfig
if BOARD_UTS2_MOTHERBOARD

config BOARD
   default "uts2_motherboard"

config SYS_CLOCK_HW_CYCLES_PER_SEC
   default 550000000

endif
```

## uts2_motherboard/boards/arm/uts2_motherboard/uts2_motherboard_defconfig
```kconfig
# SPDX-License-Identifier: Apache-2.0

# ×èï
CONFIG_SOC_SERIES_STM32H7=y
CONFIG_SOC_STM32H723VG=y
CONFIG_BOARD_UTS2_MOTHERBOARD=y

# Òàêòèðîâàíèå
CONFIG_SYS_CLOCK_HW_CYCLES_PER_SEC=550000000

# Áàçîâàÿ ïåðèôåðèÿ
CONFIG_SERIAL=y
CONFIG_UART_INTERRUPT_DRIVEN=y
CONFIG_GPIO=y
CONFIG_PINCTRL=y

# Êîíñîëü
CONFIG_CONSOLE=y
CONFIG_UART_CONSOLE=y
CONFIG_PRINTK=y
```

## uts2_work/boards/arm/uts2_motherboard/Kconfig.uts2_motherboard
```kconfig
# Copyright (c) 2020 Alexander Kozhinov <ak.alexander.kozhinov@gmail.com>
# SPDX-License-Identifier: Apache-2.0

config BOARD_UTS2_MOTHERBOARD
	select SOC_STM32H723XX
```

## uts2_work/boards/arm/uts2_motherboard/board.yml
```yaml
board:
  name: uts2_motherboard
  full_name: uts2 motherboard
  vendor: others
  socs:
    - name: stm32h723xx
```

## uts2_work/drivers/hc_595_chain/Kconfig
```kconfig
config CUSTOM_HC595_CHAIN
	bool "Custom 74HC595 Chain Driver"
	default y
	depends on SPI
	help
	  Enable support for the custom cascaded 74HC595 shift register chain.
```

## uts2_work/drivers/scan_cont_adc/Kconfig
```kconfig
config CUSTOM_SEQ_MUX_ADC
	bool "Custom STM32 Sequencer Multiplexed ADC Driver"
	default y
	# Драйвер включится автоматически, если в DTS оверлее есть активный узел с нашим compatible
	depends on DT_HAS_CUSTOM_SEQ_MUX_ADC_ENABLED
	# Автоматически подключаем зависимости, чтобы пользователю не нужно было настраивать их в prj.conf
	select DMA
	select COUNTER
	select PINCTRL
	select PINCTRL_DYNAMIC
	help
	  Enable support for the custom synchronized GPIO-ADC sequencer on STM32.
```
