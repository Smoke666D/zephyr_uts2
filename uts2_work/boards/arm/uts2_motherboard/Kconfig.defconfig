## uts2_work/boards/arm/uts2_motherboard/uts2_motherboard_defconfig
```kconfig
# SPDX-License-Identifier: Apache-2.0

# Настройки MCU
CONFIG_ARM_MPU=y
CONFIG_HW_STACK_PROTECTION=y
CONFIG_FPU=y
CONFIG_FPU_SHARING=y

CONFIG_ICACHE=y
CONFIG_DCACHE=y
CONFIG_CACHE_MANAGEMENT=y
CONFIG_NOCACHE_MEMORY=y

# Enable UART
CONFIG_SERIAL=y

# Console
CONFIG_CONSOLE=y
CONFIG_UART_CONSOLE=y

# Подключение интерфейсов
CONFIG_I2C=y
CONFIG_SPI=y
CONFIG_ADC=y
CONFIG_DAC=y
CONFIG_CAN=y
CONFIG_CAN_FD_MODE=y

CONFIG_SENSOR_ASYNC_API=y
CONFIG_I2C_STM32_V2_TIMING=y

# Подключение драйверов внешних датчиков и микросхем
CONFIG_TMP112=y
CONFIG_BH1750=y
CONFIG_GPIO_MCP230XX=y

# Подсистема датчиков (INA228)
CONFIG_SENSOR=y
CONFIG_INA228=y
CONFIG_EEPROM=y
CONFIG_EEPROM_AT24=y

# RTIO
CONFIG_RTIO=y
CONFIG_I2C_RTIO=y
CONFIG_RTIO_WORKQ_POOL_ITEMS=12

# Управление выделением памяти
CONFIG_HEAP_MEM_POOL_SIZE=16384
```
