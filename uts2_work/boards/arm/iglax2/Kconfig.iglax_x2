## uts2_work/boards/arm/iglax2/Kconfig.iglax_x2
```kconfig
# Copyright (c) 2020 Alexander Kozhinov <ak.alexander.kozhinov@gmail.com>
# SPDX-License-Identifier: Apache-2.0

config BOARD_IGLAX_X2
	select SOC_STM32F413XX
```

## uts2_work/boards/arm/iglax2/board.yml
```yaml
board:
  name: iglax_x2
  full_name: IGLAX X2
  vendor: others
  socs:
    - name: stm32f413xx
```

## uts2_work/boards/arm/iglaxfd/Kconfig.iglax_fd
```kconfig
# Copyright (c) 2020 Alexander Kozhinov <ak.alexander.kozhinov@gmail.com>
# SPDX-License-Identifier: Apache-2.0

config BOARD_IGLAX_FD
	select SOC_STM32G0B1XX
```

## uts2_work/boards/arm/iglaxfd/board.yml
```yaml
board:
  name: iglax_fd
  full_name: IGLAX FD
  vendor: others
  socs:
    - name: stm32g0b1xx
```
